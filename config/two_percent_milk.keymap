/*
 * Copyright (c) 2022 The ZMK Contributors
 *
 * SPDX-License-Identifier: MIT
 */

#include <behaviors.dtsi>
#include <dt-bindings/zmk/keys.h>

/ {
    keymap {
        compatible = "zmk,keymap";

        default_layer {
            bindings = <
&kp D  &kp  C &kp D  &kp C
            >;
        };

        layer_1 {
            bindings = <
&kp I  &kp N2  &kp I  &kp N2
            >;
        };
    };
};
